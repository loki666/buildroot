## configs/anbernic_rg35xx_plus_defconfig
```kconfig
BR2_aarch64=y
BR2_cortex_a53=y
BR2_ARM_FPU_VFPV4=y

BR2_ROOTFS_DEVICE_CREATION_DYNAMIC_MDEV=y
BR2_SYSTEM_DHCP=""

BR2_GLOBAL_PATCH_DIR="board/anbernic/rg35xx-plus/patches"

# Firmware
BR2_TARGET_ARM_TRUSTED_FIRMWARE=y
#BR2_TARGET_ARM_TRUSTED_FIRMWARE_CUSTOM_VERSION=y
#BR2_TARGET_ARM_TRUSTED_FIRMWARE_CUSTOM_VERSION_VALUE="lts-v2.10.4"
BR2_TARGET_ARM_TRUSTED_FIRMWARE_CUSTOM_GIT=y
BR2_TARGET_ARM_TRUSTED_FIRMWARE_CUSTOM_REPO_URL="https://github.com/ARM-software/arm-trusted-firmware"
BR2_TARGET_ARM_TRUSTED_FIRMWARE_CUSTOM_REPO_VERSION="bccc22756a32e39fbc7c0a8895814da764d9f422"
BR2_TARGET_ARM_TRUSTED_FIRMWARE_PLATFORM="sun50i_h616"
BR2_TARGET_ARM_TRUSTED_FIRMWARE_BL31=y

# Bootloader
BR2_TARGET_UBOOT=y
BR2_TARGET_UBOOT_BUILD_SYSTEM_KCONFIG=y
BR2_TARGET_UBOOT_CUSTOM_GIT=y
BR2_TARGET_UBOOT_CUSTOM_REPO_URL="https://github.com/u-boot/u-boot"
BR2_TARGET_UBOOT_CUSTOM_REPO_VERSION="v2025.01-rc2"
BR2_TARGET_UBOOT_BOARD_DEFCONFIG="anbernic_rg35xx_h700"

BR2_TARGET_UBOOT_NEEDS_DTC=y
BR2_TARGET_UBOOT_NEEDS_OPENSSL=y
BR2_TARGET_UBOOT_NEEDS_PYTHON3=y
BR2_TARGET_UBOOT_NEEDS_PYLIBFDT=y
BR2_TARGET_UBOOT_NEEDS_ATF_BL31=y
BR2_TARGET_UBOOT_SPL=y
BR2_TARGET_UBOOT_SPL_NAME="u-boot-sunxi-with-spl.bin"
BR2_TARGET_UBOOT_CUSTOM_MAKEOPTS="SCP=/dev/null"

# Linux headers same as kernel, a 6.1 series
BR2_PACKAGE_HOST_LINUX_HEADERS_CUSTOM_6_9=y

# Kernel
BR2_LINUX_KERNEL=y
BR2_LINUX_KERNEL_CUSTOM_TARBALL=y
BR2_LINUX_KERNEL_CUSTOM_TARBALL_LOCATION="https://git.kernel.org/torvalds/t/linux-6.12-rc3.tar.gz"
BR2_LINUX_KERNEL_DTS_SUPPORT=y
BR2_LINUX_KERNEL_INTREE_DTS_NAME="allwinner/sun50i-h700-anbernic-rg35xx-plus"
BR2_LINUX_KERNEL_NEEDS_HOST_OPENSSL=y
BR2_LINUX_KERNEL_INSTALL_TARGET=y
BR2_LINUX_KERNEL_USE_CUSTOM_CONFIG=y
BR2_LINUX_KERNEL_CUSTOM_CONFIG_FILE="board/anbernic/rg35xx-plus/rocknix-h700.config"

# Filesystem
BR2_TARGET_GENERIC_ISSUE="Welcome to Anbernic RG35XX Plus/H"
BR2_TARGET_ROOTFS_EXT2=y
BR2_TARGET_ROOTFS_EXT2_4=y
BR2_TARGET_ROOTFS_EXT2_SIZE="512M"
# BR2_TARGET_ROOTFS_TAR is not set

# host tools
BR2_PACKAGE_HOST_GENIMAGE=y
BR2_PACKAGE_HOST_UBOOT_TOOLS=y

# image scripts
BR2_ROOTFS_POST_BUILD_SCRIPT="board/anbernic/rg35xx-plus/post-build.sh"
BR2_ROOTFS_POST_IMAGE_SCRIPT="support/scripts/genimage.sh"
BR2_ROOTFS_POST_SCRIPT_ARGS="-c $(BINARIES_DIR)/genimage.cfg"

BR2_PACKAGE_BUSYBOX_CONFIG_FRAGMENT_FILES="board/anbernic/rg35xx-plus/busybox.config"

# Target packages
BR2_ROOTFS_OVERLAY="board/anbernic/rg35xx-plus/fs-overlay"
BR2_PACKAGE_DROPBEAR=y
BR2_TARGET_ENABLE_ROOT_LOGIN=y
BR2_TARGET_GENERIC_ROOT_PASSWD="linux"

# wireless support
BR2_PACKAGE_WIRELESS_REGDB=y
BR2_PACKAGE_IW=y
BR2_PACKAGE_WIRELESS_TOOLS=y
BR2_PACKAGE_WIRELESS_TOOLS_LIB=y
BR2_PACKAGE_LINUX_FIRMWARE=y
BR2_PACKAGE_LINUX_FIRMWARE_RTL_88XX_BT=y
BR2_PACKAGE_LINUX_FIRMWARE_RTL_RTW88=y
BR2_PACKAGE_IWD=y
BR2_PACKAGE_BLUEZ5_UTILS=y
BR2_PACKAGE_BLUEZ5_UTILS_CLIENT=y

#BR2_PACKAGE_BUSYBOX_SHOW_OTHERS=y
#BR2_PACKAGE_BASH=y

#BR2_PACKAGE_STRESS_NG=y
#BR2_PACKAGE_RNG_TOOLS=y

#BR2_PACKAGE_ALSA_UTILS=y
#BR2_PACKAGE_ALSA_UTILS_ALSAMIXER=y
#BR2_PACKAGE_ALSA_UTILS_AMIXER=y
#BR2_PACKAGE_ALSA_UTILS_APLAY=y
#BR2_PACKAGE_ALSA_UTILS_SPEAKER_TEST=y

BR2_TOOLCHAIN_BUILDROOT_CXX=y
BR2_PACKAGE_EUDEV=y
BR2_ROOTFS_DEVICE_CREATION_DYNAMIC_EUDEV=y

#BR2_PACKAGE_MESA3D=y
#BR2_PACKAGE_MESA3D_OPENGL_EGL=y
#BR2_PACKAGE_MESA3D_OPENGL_ES=y
#BR2_PACKAGE_MESA3D_GALLIUM_DRIVER_PANFROST=y

BR2_PACKAGE_ROCKCHIP_MALI=y
BR2_PACKAGE_GLMARK2=y
BR2_PACKAGE_GLMARK2_FLAVOR_DRM_GLESV2=y
```

## configs/magicx_mini_zero28_defconfig
```kconfig
BR2_aarch64=y
BR2_cortex_a53=y
BR2_ARM_FPU_VFPV4=y

BR2_ROOTFS_DEVICE_CREATION_DYNAMIC_MDEV=y
BR2_SYSTEM_DHCP=""

BR2_GLOBAL_PATCH_DIR="board/magicx/mini_zero28/patches"

# Firmware
BR2_TARGET_ARM_TRUSTED_FIRMWARE=y
#BR2_TARGET_ARM_TRUSTED_FIRMWARE_CUSTOM_VERSION=y
#BR2_TARGET_ARM_TRUSTED_FIRMWARE_CUSTOM_VERSION_VALUE="v2.12.0"
BR2_TARGET_ARM_TRUSTED_FIRMWARE_CUSTOM_GIT=y
BR2_TARGET_ARM_TRUSTED_FIRMWARE_CUSTOM_REPO_URL="https://github.com/ARM-software/arm-trusted-firmware"
BR2_TARGET_ARM_TRUSTED_FIRMWARE_CUSTOM_REPO_VERSION="3ab2df8de968f1d8a9ef13f45c9e1a073c5b1b70"
BR2_TARGET_ARM_TRUSTED_FIRMWARE_PLATFORM="sun50i_h6"
BR2_TARGET_ARM_TRUSTED_FIRMWARE_BL31=y

# Bootloader
BR2_TARGET_UBOOT=y
BR2_TARGET_UBOOT_BUILD_SYSTEM_KCONFIG=y
BR2_TARGET_UBOOT_CUSTOM_GIT=y
BR2_TARGET_UBOOT_CUSTOM_REPO_URL="https://github.com/kikuchan/u-boot"
BR2_TARGET_UBOOT_CUSTOM_REPO_VERSION="2b6a68fa90634f33c158a0d91ca13072d5f0bad6"
BR2_TARGET_UBOOT_BOARD_DEFCONFIG="magicx_mini_zero28_a133p"

BR2_TARGET_UBOOT_NEEDS_DTC=y
BR2_TARGET_UBOOT_NEEDS_OPENSSL=y
BR2_TARGET_UBOOT_NEEDS_PYTHON3=y
BR2_TARGET_UBOOT_NEEDS_PYLIBFDT=y
BR2_TARGET_UBOOT_NEEDS_ATF_BL31=y
BR2_TARGET_UBOOT_SPL=y
BR2_TARGET_UBOOT_SPL_NAME="u-boot-sunxi-with-spl.bin"
BR2_TARGET_UBOOT_CUSTOM_MAKEOPTS="SCP=/dev/null"

BR2_PACKAGE_HOST_LINUX_HEADERS_CUSTOM_6_11=y

# Kernel
BR2_LINUX_KERNEL=y
BR2_LINUX_KERNEL_CUSTOM_TARBALL=y
BR2_LINUX_KERNEL_CUSTOM_TARBALL_LOCATION="https://git.kernel.org/torvalds/t/linux-6.14-rc2.tar.gz"
BR2_LINUX_KERNEL_DTS_SUPPORT=y
BR2_LINUX_KERNEL_INTREE_DTS_NAME="allwinner/sun50i-a133p-magicx-minizero28"
BR2_LINUX_KERNEL_NEEDS_HOST_OPENSSL=y
BR2_LINUX_KERNEL_INSTALL_TARGET=y
BR2_LINUX_KERNEL_USE_CUSTOM_CONFIG=y
BR2_LINUX_KERNEL_CUSTOM_CONFIG_FILE="board/magicx/mini_zero28/linux.aarch64.conf"

# Filesystem
BR2_TARGET_GENERIC_ISSUE="Welcome to Anbernic RG35XX Plus/H"
BR2_TARGET_ROOTFS_EXT2=y
BR2_TARGET_ROOTFS_EXT2_4=y
BR2_TARGET_ROOTFS_EXT2_SIZE="512M"
# BR2_TARGET_ROOTFS_TAR is not set

# host tools
BR2_PACKAGE_HOST_GENIMAGE=y
BR2_PACKAGE_HOST_UBOOT_TOOLS=y

# image scripts
BR2_ROOTFS_POST_BUILD_SCRIPT="board/magicx/mini_zero28/post-build.sh"
BR2_ROOTFS_POST_IMAGE_SCRIPT="support/scripts/genimage.sh"
BR2_ROOTFS_POST_SCRIPT_ARGS="-c $(BINARIES_DIR)/genimage.cfg"

#BR2_PACKAGE_BUSYBOX_CONFIG_FRAGMENT_FILES="board/magicx/mini_zero28/busybox.config"

# Target packages
#BR2_ROOTFS_OVERLAY="board/magicx/mini_zero28/fs-overlay"
#BR2_PACKAGE_DROPBEAR=y
#BR2_TARGET_ENABLE_ROOT_LOGIN=y
#BR2_TARGET_GENERIC_ROOT_PASSWD="linux"

# wireless support
#BR2_PACKAGE_WIRELESS_REGDB=y
#BR2_PACKAGE_IW=y
#BR2_PACKAGE_WIRELESS_TOOLS=y
#BR2_PACKAGE_WIRELESS_TOOLS_LIB=y
#BR2_PACKAGE_LINUX_FIRMWARE=y
#BR2_PACKAGE_LINUX_FIRMWARE_RTL_88XX_BT=y
#BR2_PACKAGE_LINUX_FIRMWARE_RTL_RTW88=y
#BR2_PACKAGE_IWD=y

#BR2_PACKAGE_LIBGPIOD=y
#BR2_PACKAGE_LIBGPIOD_TOOLS=y

#BR2_PACKAGE_LINUXCONSOLETOOLS=y
#BR2_PACKAGE_LINUXCONSOLETOOLS_FORCEFEEDBACK=y

#BR2_PACKAGE_BUSYBOX_SHOW_OTHERS=y
#BR2_PACKAGE_BASH=y
#BR2_PACKAGE_STRESS_NG=y
#BR2_PACKAGE_RNG_TOOLS=y

#BR2_PACKAGE_ALSA_UTILS=y
#BR2_PACKAGE_ALSA_UTILS_ALSAMIXER=y
#BR2_PACKAGE_ALSA_UTILS_AMIXER=y
#BR2_PACKAGE_ALSA_UTILS_APLAY=y
#BR2_PACKAGE_ALSA_UTILS_SPEAKER_TEST=y

#BR2_TOOLCHAIN_BUILDROOT_CXX=y
#BR2_PACKAGE_EUDEV=y
#BR2_ROOTFS_DEVICE_CREATION_DYNAMIC_EUDEV=y

#BR2_PACKAGE_MESA3D=y
#BR2_PACKAGE_MESA3D_OPENGL_EGL=y
#BR2_PACKAGE_MESA3D_OPENGL_ES=y
#BR2_PACKAGE_MESA3D_GALLIUM_DRIVER_PANFROST=y
#BR2_PACKAGE_GLMARK2=y
#BR2_PACKAGE_GLMARK2_FLAVOR_DRM_GLESV2=y
```
